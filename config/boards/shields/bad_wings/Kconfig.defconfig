## config/boards/shields/bad_wings/Kconfig.defconfig
```kconfig
# Copyright (c) 2022 The ZMK Contributors
# SPDX-License-Identifier: MIT

if SHIELD_BAD_WINGS_DONGLE 

config ZMK_KEYBOARD_NAME
    default "Bad Wings"

config ZMK_USB
    default y

config ZMK_BLE
    default y

config ZMK_SPLIT_ROLE_CENTRAL
    default y

config ZMK_SPLIT
    default y

endif
```

## config/boards/shields/bad_wings/Kconfig.shield
```kconfig
# Copyright (c) 2022 The ZMK Contributors
# SPDX-License-Identifier: MIT

config SHIELD_BAD_WINGS_MAIN
    def_bool $(shields_list_contains,bad_wings_main)
    select SPI

config SHIELD_BAD_WINGS_DONGLE
    def_bool $(shields_list_contains,bad_wings_dongle)
```
